## config/boards/shields/splitkb_aurora_sofle/Kconfig.defconfig
```kconfig
if SHIELD_SPLITKB_AURORA_SOFLE_DONGLE

config ZMK_KEYBOARD_NAME
    default "Aurora Sofle"

config ZMK_SPLIT
    default y

config ZMK_SPLIT_ROLE_CENTRAL
    default y

config ZMK_SPLIT_BLE_CENTRAL_PERIPHERALS
    default 2

endif
```
